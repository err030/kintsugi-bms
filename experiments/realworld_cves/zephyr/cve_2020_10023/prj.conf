## CMakeLists.txt
```
# SPDX-License-Identifier: Apache-2.0

cmake_minimum_required(VERSION 3.20.0)
find_package(Zephyr REQUIRED HINTS $ENV{ZEPHYR_BASE})
project(cve_2020_10023)

FILE(GLOB app_sources src/*.c)
target_sources(app PRIVATE ${app_sources})
zephyr_include_directories(include)
include_directories_ifdef(CONFIG_HOTPATCH ../../../../hotpatches/include)
target_sources_ifdef(CONFIG_HOTPATCH app PRIVATE ../../../../hotpatches/zephyr/cve_2020_10023.c)

if(CONFIG_BUILD_WITH_TFM)
  target_include_directories(app PRIVATE
    $<TARGET_PROPERTY:tfm,TFM_BINARY_DIR>/install/interface/include
  )
endif()
```

## prj.conf
```kconfig
CONFIG_SHELL=y
CONFIG_SHELL_BACKEND_SERIAL=n
CONFIG_SHELL_BACKEND_DUMMY=y
CONFIG_SHELL_CMDS_SELECT=y
CONFIG_SHELL_CMD_BUFF_SIZE=90
CONFIG_SHELL_PRINTF_BUFF_SIZE=15
CONFIG_SHELL_METAKEYS=n
CONFIG_LOG=y

CONFIG_HEAP_MEM_POOL_SIZE=21504

CONFIG_MAIN_STACK_SIZE=16384
CONFIG_COMMON_LIBC_MALLOC_ARENA_SIZE=16384

#CONFIG_XIP=n
CONFIG_HOTPATCH=y
CONFIG_BUILD_OUTPUT_HEX=y
#CONFIG_BOOTLOADER_MCUBOOT=y
#CONFIG_TIMESLICE_PER_THREAD=y

CONFIG_WATCHDOG=y
CONFIG_LOG=y
CONFIG_LOG_MODE_OVERFLOW=y
CONFIG_LOG_SPEED=y

CONFIG_PIPES=y

CONFIG_NO_OPTIMIZATIONS=n
#CONFIG_MPU_STACK_GUARD=n
#CONFIG_TIMING_FUNCTIONS=y

CONFIG_LOG_RUNTIME_FILTERING=y

# Generic networking options
CONFIG_NETWORKING=y

# enable the MQTT lib
CONFIG_MQTT_LIB=y
```

## src/main.c
```c
#include <zephyr/kernel.h>
#include <zephyr/logging/log.h>
#include <zephyr/shell/shell.h>
#include <zephyr/shell/shell_dummy.h>
#include <zephyr/random/rand32.h>
#include <stdio.h>

#include "hp_code_data.h"


LOG_MODULE_REGISTER(main);

void
hp_manager_task(void *parameters) {

    uint32_t identifier = 0;
    printf("Starting Kintsugi Hotpatch Manager Task\r\n");

    hp_manager(HOTPATCH_CODE, sizeof(HOTPATCH_CODE), &identifier);

    while (1) {
        k_sleep(K_MSEC(10));
    }
}

int main_task(void)
{

	while(1) {
		char str1[] = "aabaaaa  c";
		char exp1[] = "aabaaaa c";
		char str2[] = "aab  aa   aa  c";
		char exp2[] = "aab aa aa c";
		int rv;

		printk("Start\r\n");

		int line = 0;
		z_shell_spaces_trim(str1);
		printk("%s | %s\r\n", str1, exp1);
		rv = strcmp(str1, exp1);
		if (rv != 0) {
			printk("%s => %s\n", str1, exp1);
			printk("%d - %s\n", rv, "Unexepected value");
			line = 1;
		}

		z_shell_spaces_trim(str2);
		printk("%s | %s\r\n", str2, exp2);
		rv = strcmp(str2, exp2);
		if (rv != 0) {

			printk("%s => %s\n", str2, exp2);
			printk("%d - %s\n", rv, "Unexepected value");
			line = 1;
		}

		if (line == 1) {
			printk("\n----------------------\n");
		}
		k_msleep(5000);
	}
	return 0;
}


#define STACKSIZE 2028
#define PRIORITY  -2
K_THREAD_DEFINE(main_id, STACKSIZE, 
				main_task, NULL, NULL, NULL,
				PRIORITY, 0, 0);

				#define STACKSIZE (512 * 4)
#define PRIORITY  CONFIG_NUM_PREEMPT_PRIORITIES - 1
K_THREAD_DEFINE(HP_TASK, STACKSIZE, hp_manager_task, NULL, NULL, NULL, PRIORITY, 0, 0);
```

## include/hp_code_data.h
```c
/* AUTOGENERATED FILE BY KINTSUGI */
#ifndef HP_HOTPATCH_CODE_H_
#define HP_HOTPATCH_CODE_H_

#include <stdint.h>

static const uint8_t HOTPATCH_CODE[40] = {
        0x01, 0x00, 0x00, 0x00, 0x86, 0x27, 0x00, 0x20, 
        0x18, 0x00, 0x00, 0x00, 0x00, 0x00, 0x00, 0x00, 
        0x44, 0x1A, 0x62, 0x1C, 0xC4, 0x1A, 0x31, 0x44, 
        0x70, 0x19, 0xDF, 0xF8, 0x02, 0xF0, 0x8F, 0x27, 
        0x00, 0x20, 0x00, 0xBF, 0x00, 0xBF, 0x00, 0xBF
};

#endif /* HP_HOTPATCH_CODE_H_ */
```

## include/hp_config.h
```c
#ifndef HP_CONFIG_H_
#define HP_CONFIG_H_

#include "hp_def.h"

#define HP_CONFIG_ZEPHYROS  1
#define HP_CONFIG_LOG       0

#define HP_SLOT_COUNT         10
#define HP_MAX_CODE_SIZE      256

#if defined(HP_MEASURE_NUM_HOTPATCHES)
#define HP_APPLICATOR_ENTRY_COUNT   HP_MEASURE_NUM_HOTPATCHES
#else
#define HP_APPLICATOR_ENTRY_COUNT   5
#endif

// memory configuartions
#define HP_CODE_MEMORY_SIZE         (HP_SLOT_COUNT * HP_MAX_CODE_SIZE)
#define HP_CODE_MEMORY_MAX_ALLOC    (HP_MAX_CODE_SIZE)

// frequency of the board (in MHz)
#define HP_BOARD_FREQUENCY_NRF52    64
#define HP_BOARD_FREQUENCY          HP_BOARD_FREQUENCY_NRF52

#endif // HP_CONFIG_H_
```
