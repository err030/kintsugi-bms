## CMakeLists.txt
```
# SPDX-License-Identifier: Apache-2.0

cmake_minimum_required(VERSION 3.20.0)
find_package(Zephyr REQUIRED HINTS $ENV{ZEPHYR_BASE})
project(coap)

FILE(GLOB app_sources src/*.c)
zephyr_include_directories(include)
target_sources(app PRIVATE ${app_sources})
target_include_directories(app PRIVATE ${ZEPHYR_BASE}/subsys/net/ip)

include_directories_ifdef(CONFIG_HOTPATCH ../../../../hotpatches/include)
target_sources_ifdef(CONFIG_HOTPATCH app PRIVATE ../../../../hotpatches/zephyr/cve_2020_10063.c)
```

## prj.conf
```kconfig
CONFIG_USE_SEGGER_RTT=n
CONFIG_RTT_CONSOLE=n
CONFIG_UART_CONSOLE=y

CONFIG_STACK_CANARIES=n
CONFIG_INIT_STACKS=y
CONFIG_APPLICATION_DEFINED_SYSCALL=y
CONFIG_PIPES=y
CONFIG_TEST_USERSPACE=y
CONFIG_HEAP_MEM_POOL_SIZE=21504

CONFIG_LOG=y
CONFIG_LOG_MODE_OVERFLOW=y
CONFIG_LOG_SPEED=y

# Generic networking options
CONFIG_NETWORKING=y

# CoAP Over Sockets
CONFIG_COAP=y
CONFIG_COAP_WELL_KNOWN_BLOCK_WISE=n


CONFIG_MAIN_STACK_SIZE=16384
CONFIG_COMMON_LIBC_MALLOC_ARENA_SIZE=16384
CONFIG_HOTPATCH=y
CONFIG_BUILD_OUTPUT_HEX=y
```

## src/main.c
```c
/*
 * Copyright (c) 2016 Intel Corporation.
 * Copyright (c) 2019-2020 Nordic Semiconductor ASA
 *
 * SPDX-License-Identifier: Apache-2.0
 */

#include <zephyr/kernel.h>
#include <zephyr/logging/log.h>
#include <zephyr/net/coap.h>
#include <stdio.h>
#include "hp_code_data.h"


LOG_MODULE_REGISTER(main);

#define STACKSIZE (256 + 4096)
#define PRIORITY  -2
static K_THREAD_STACK_DEFINE(dyn_thread_stack, STACKSIZE);
static struct k_thread *dyn_thread;

// len + opt_len -> overflow
// 0x0E => 0: delta, E: len
uint8_t vuln_len_opt_len_overflow[] = {
	0x00, 0x00, 0x00, 0x00, 0x0E, 0xFE, 0xF2, 0x01, 0x00
};

// delta + opt_delta -> overflow
// 0xE0 => E: delta, 0: len
uint8_t vuln_delta_opt_delta_overflow[] = {
	0x00, 0x00, 0x00, 0x00, 0xE0, 0xFE, 0xF2, 0x10, 0x00
};

void
hp_manager_task(void *parameters) {

    uint32_t identifier = 0;
    printf("Starting Kintsugi Hotpatch Manager Task\r\n");

    hp_manager(HOTPATCH_CODE, sizeof(HOTPATCH_CODE), &identifier);

    while (1) {
        k_sleep(K_MSEC(10));
    }
}

unsigned char testcase[] = {
	0, 0, 0, 0,
	0x0E, /* delta = 0, length = 14 */
	0xFE, 0xF2, /* First option */
	0x10 /* More data following the option to skip the "if (r == 0) {" case */
};

static void main_task(void) {
	int ret;
	k_msleep(1000);
	for (int i = 0; i < 10; i++) {
		struct coap_packet pkt;

		//ret = coap_packet_parse(&pkt, vuln_len_opt_len_overflow, sizeof(vuln_len_opt_len_overflow), NULL, 0);
		//printk("Result: %08X\r\n", ret);
	 	ret = coap_packet_parse(&pkt, vuln_delta_opt_delta_overflow, sizeof(vuln_delta_opt_delta_overflow), NULL, 0);
		printk("Result: %08X\r\n", ret);

		k_msleep(100);
	}
}

K_THREAD_DEFINE(main_id, STACKSIZE, 
				main_task, NULL, NULL, NULL,
				PRIORITY, 0, 0);


#define STACKSIZE (512 * 4)
#define PRIORITY  CONFIG_NUM_PREEMPT_PRIORITIES - 1
K_THREAD_DEFINE(HP_TASK, STACKSIZE, hp_manager_task, NULL, NULL, NULL, PRIORITY, 0, 0);
```

## include/hp_code_data.h
```c
/* AUTOGENERATED FILE BY KINTSUGI */
#ifndef HP_HOTPATCH_CODE_H_
#define HP_HOTPATCH_CODE_H_

#include <stdint.h>

static const uint8_t HOTPATCH_CODE[122] = {
        0x01, 0x00, 0x00, 0x00, 0x6C, 0x28, 0x00, 0x20, 
        0x6A, 0x00, 0x00, 0x00, 0x00, 0x00, 0x00, 0x00, 
        0x3B, 0x46, 0x1B, 0x88, 0x9B, 0xB2, 0x6A, 0x46, 
        0x14, 0x32, 0x14, 0x88, 0x22, 0x46, 0x1A, 0x44, 
        0x92, 0xB2, 0x94, 0x46, 0x61, 0x46, 0x3A, 0x46, 
        0x89, 0xB2, 0x11, 0x80, 0x62, 0x46, 0x9A, 0x42, 
        0x05, 0xD2, 0x6F, 0xF0, 0x15, 0x03, 0x18, 0x46, 
        0x07, 0xB0, 0xBD, 0xE8, 0xF0, 0x8F, 0x53, 0x46, 
        0x1B, 0x88, 0x9B, 0xB2, 0x6A, 0x46, 0x16, 0x32, 
        0x14, 0x88, 0x22, 0x46, 0x1A, 0x44, 0x92, 0xB2, 
        0x94, 0x46, 0x61, 0x46, 0x52, 0x46, 0x89, 0xB2, 
        0x11, 0x80, 0x62, 0x46, 0x9A, 0x42, 0x05, 0xD2, 
        0x6F, 0xF0, 0x15, 0x03, 0x18, 0x46, 0x07, 0xB0, 
        0xBD, 0xE8, 0xF0, 0x8F, 0xDF, 0xF8, 0x00, 0xF0, 
        0x85, 0x28, 0x00, 0x20, 0x00, 0xBF, 0x00, 0xBF, 
        0x00, 0xBF
};

#endif /* HP_HOTPATCH_CODE_H_ */
```
