## CMakeLists.txt
```
# SPDX-License-Identifier: Apache-2.0

cmake_minimum_required(VERSION 3.20.0)

find_package(Zephyr REQUIRED HINTS $ENV{ZEPHYR_BASE})
project(mqtt_packet)

target_include_directories(app PRIVATE
	${ZEPHYR_BASE}/subsys/net/ip
	${ZEPHYR_BASE}/subsys/net/lib/mqtt
	)
FILE(GLOB app_sources src/*.c)
zephyr_include_directories(include)
target_sources(app PRIVATE ${app_sources})

include_directories_ifdef(CONFIG_HOTPATCH ../../../../hotpatches/include)
target_sources_ifdef(CONFIG_HOTPATCH app PRIVATE ../../../../hotpatches/zephyr/cve_2020_10062.c)
```

## prj.conf
```kconfig
CONFIG_SHELL=y
CONFIG_SHELL_BACKEND_SERIAL=n
CONFIG_SHELL_BACKEND_DUMMY=y
CONFIG_SHELL_CMDS_SELECT=y
CONFIG_SHELL_CMD_BUFF_SIZE=90
CONFIG_SHELL_PRINTF_BUFF_SIZE=15
CONFIG_SHELL_METAKEYS=n
CONFIG_LOG=y

CONFIG_HEAP_MEM_POOL_SIZE=21504

CONFIG_MAIN_STACK_SIZE=16384
CONFIG_COMMON_LIBC_MALLOC_ARENA_SIZE=16384

#CONFIG_XIP=n
CONFIG_HOTPATCH=y
CONFIG_BUILD_OUTPUT_HEX=y
#CONFIG_BOOTLOADER_MCUBOOT=y
#CONFIG_TIMESLICE_PER_THREAD=y

CONFIG_WATCHDOG=y
CONFIG_LOG=y
CONFIG_LOG_MODE_OVERFLOW=y
CONFIG_LOG_SPEED=y

CONFIG_PIPES=y

CONFIG_NO_OPTIMIZATIONS=n
CONFIG_MPU_STACK_GUARD=n
CONFIG_TIMING_FUNCTIONS=y

CONFIG_LOG_RUNTIME_FILTERING=y

# Generic networking options
CONFIG_NETWORKING=y

# enable the MQTT lib
CONFIG_MQTT_LIB=y
```

## src/main.c
```c
/*
 * Copyright (c) 2016 Intel Corporation.
 * Copyright (c) 2019-2020 Nordic Semiconductor ASA
 *
 * SPDX-License-Identifier: Apache-2.0
 */

#include <zephyr/kernel.h>
#include <zephyr/logging/log.h>
#include <mqtt_internal.h>

#include <stdio.h>

#include "hp_code_data.h"


LOG_MODULE_REGISTER(main);

void
hp_manager_task(void *parameters) {

    uint32_t identifier = 0;
    printf("Starting Kintsugi Hotpatch Manager Task\r\n");

    hp_manager(HOTPATCH_CODE, sizeof(HOTPATCH_CODE), &identifier);

    while (1) {
        k_sleep(K_MSEC(10));
    }
}


int main_task(void)
{
	/*
	k_sched_lock();
	for (int i = 0; i < 10000; i++) {
		hotpatch_measurement_encapsulation();
	}
	k_sched_unlock();
	*/
	for (int i = 0; i < 10; i++) {
		int rc;
		uint8_t flags;
		uint32_t length;

		uint8_t corrupted_pkt_len[] = {0x30, 0xff, 0xff, 0xff, 0xff, 0x01};
		struct buf_ctx corrupted_pkt_len_buf = {
			.cur = corrupted_pkt_len,
			.end = corrupted_pkt_len + sizeof(corrupted_pkt_len)
		};
		rc = fixed_header_decode(&corrupted_pkt_len_buf, &flags, &length);
		printk("%d - Result: %08X\r\n", i, rc);
		k_msleep(1000);
	}

	while (1) {
		k_msleep(1000);
	}
}




#define STACKSIZE 512
#define PRIORITY  2
K_THREAD_DEFINE(main_id, STACKSIZE, 
				main_task, NULL, NULL, NULL,
				PRIORITY, 0, 0);

#define STACKSIZE (512 * 4)
#define PRIORITY  CONFIG_NUM_PREEMPT_PRIORITIES - 1
K_THREAD_DEFINE(HP_TASK, STACKSIZE, hp_manager_task, NULL, NULL, NULL, PRIORITY, 0, 0);
```

## include/hp_code_data.h
```c
/* AUTOGENERATED FILE BY KINTSUGI */
#ifndef HP_HOTPATCH_CODE_H_
#define HP_HOTPATCH_CODE_H_

#include <stdint.h>

static const uint8_t HOTPATCH_CODE[144] = {
        0x01, 0x00, 0x00, 0x00, 0xD8, 0x27, 0x00, 0x20, 
        0x80, 0x00, 0x00, 0x00, 0x00, 0x00, 0x00, 0x00, 
        0x7E, 0xB4, 0x00, 0x25, 0x00, 0x24, 0x0B, 0x46, 
        0x00, 0x22, 0x1A, 0x60, 0x03, 0x2C, 0x04, 0xD9, 
        0x6F, 0xF0, 0x15, 0x03, 0x18, 0x46, 0x7E, 0xBC, 
        0x10, 0xBD, 0x03, 0x46, 0x1A, 0x68, 0x03, 0x46, 
        0x5B, 0x68, 0x9A, 0x42, 0x04, 0xD3, 0x6F, 0xF0, 
        0x0A, 0x03, 0x18, 0x46, 0x7E, 0xBC, 0x10, 0xBD, 
        0x03, 0x46, 0x1B, 0x68, 0x1B, 0x78, 0x03, 0xF0, 
        0x7F, 0x03, 0x2A, 0x46, 0x03, 0xFA, 0x02, 0xF2, 
        0x0B, 0x46, 0x1B, 0x68, 0x13, 0x44, 0x0B, 0x60, 
        0xEB, 0x1D, 0xDD, 0xB2, 0x23, 0x46, 0x01, 0x33, 
        0xDC, 0xB2, 0x02, 0x46, 0x13, 0x68, 0x5E, 0x1C, 
        0x16, 0x60, 0x1B, 0x78, 0x5B, 0xB2, 0x00, 0x2B, 
        0xD4, 0xDB, 0x0B, 0x46, 0x1B, 0x68, 0xB3, 0xF1, 
        0x80, 0x5F, 0x04, 0xD3, 0x6F, 0xF0, 0x15, 0x03, 
        0x18, 0x46, 0x7E, 0xBC, 0x10, 0xBD, 0x00, 0x23, 
        0x18, 0x46, 0x7E, 0xBC, 0x10, 0xBD, 0x00, 0xBF
};

#endif /* HP_HOTPATCH_CODE_H_ */
```
